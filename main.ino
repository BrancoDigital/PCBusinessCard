/*
  PCBusiness Card
  Description: A digital businesscard using an ESP01, PCF8574 and SSD1306 OLED.
  Version: 1.0
  Date: 2023-06-12
  Author: Luis Branco | Branco Digital UG (haftungsbeschränkt)
  Email: luis@brancodigital.de
  GitHub: https://github.com/BrancoDigital
  License: This work is licensed under <TBD>
*/

#include <Wire.h>
#include <Adafruit_GFX.h>
#include <Adafruit_SSD1306.h>
#include <Adafruit_PCF8574.h>
#include <cstring>
#include <qrcode.h>


#define SCREEN_WIDTH 128 // OLED display width, in pixels
#define SCREEN_HEIGHT 64 // OLED display height, in pixels

//#define PCF8574_ADDRESS 0x20 // Adjust to your PCF8574 address, found with the I2C scanner sketch
#define SDA_PIN 2  // GPIO2
#define SCL_PIN 0  // GPIO0

// create an instance of the PCF8574 library
//PCF8574 pcf8574(PCF8574_ADDRESS);

Adafruit_PCF8574 pcf;

// Create a QR code object
QRCode qrcode;

#define OLED_RESET     -1 // Reset pin # (or -1 if sharing Arduino reset pin)
// #define OLED_RESET pcf8574.pin[0] // Reset pin is first pin on PCF8574 //Only if OLED has reset pin
#define SCREEN_ADDRESS 0x3C ///< See datasheet for Address; 0x3D for 128x64, 0x3C for 128x32

//Define Buttons
#define btnBACK    0  // on the GPIO expander!
#define btnCONFIRM 1  // on the GPIO expander!
#define btnDOWN      2  // on the GPIO expander!
#define btnUP    3  // on the GPIO expander!


Adafruit_SSD1306 display(SCREEN_WIDTH, SCREEN_HEIGHT, &Wire, OLED_RESET);

//// MENU ITEMS ////

//Enumerate Menu Entry Types
enum PageType {
  PAGE_TEXT,
  PAGE_BITMAP,
  PAGE_QRCODE
};

// Add a qrCodeIndex to the MenuItem structure
struct MenuItem {
  String label;
  PageType type; // We now use the type instead of isBitmap
  union {
    int subpageIndex; // Index into subPages[] for text content
    int bitmapIndex; // Index into bitmaps[] for bitmap content
    int qrCodeIndex; // Index into qrContents[] for QR code content
  };
};

// Define the menu
MenuItem menuItems[] = {
  {"Page 1", PAGE_TEXT, .subpageIndex = 1},
  {"Page 2", PAGE_TEXT, .subpageIndex = 2},
  {"Page 3", PAGE_TEXT, .subpageIndex = 3},
  {"Page 4", PAGE_TEXT, .subpageIndex = 4},
  {"QR Code", PAGE_QRCODE, .qrCodeIndex = 0}, // QR code with URL
  {"Bitmap", PAGE_BITMAP, .bitmapIndex = 0},
  // ... more items ...
};

//// SUB PAGES ////

// Define the contents of each subpage as a C-style string (char array)
// You need to ensure that the array size is enough to hold your largest subpage, including the null-terminator.
// In this example, we assume that 500 is sufficient.

#define MAX_SUBPAGE_LENGTH 1000

char subPages[][MAX_SUBPAGE_LENGTH] = {
    //Subpage 1
    "SUBPAGE 1\n\nLorem ipsum dolor sit amet, consectetur adipiscing elit. Nullam vehicula feugiat tellus, nec ultrices lacus. Nullam quis lectus at nisi tempor convallis.",
    //Subpage 2
    "SUBPAGE 2\n\nCurabitur pellentesque neque eget diam posuere porta. Quisque ut nulla at nunc vehicula lacinia. Proin adipiscing porta tellus, ut feugiat nibh adipiscing sit amet.",
    //Subpage 3
    "SUBPAGE 3\n\nIn eu justo a felis faucibus ornare vel id metus. Sed hendrerit enim non justo posuere placerat. Phasellus eget purus vel mauris tincidunt tincidunt.",
    //Subpage 4
    "SUBPAGE 4\n\nSed auctor neque eu tellus rhoncus ut eleifend nibh porttitor. Ut in nulla enim. Phasellus molestie magna non est bibendum non venenatis nisl tempor.",
    //Subpage 5
    "SUBPAGE 5\n\nSuspendisse dictum feugiat nisl ut dapibus. Mauris iaculis porttitor posuere. Praesent id metus massa, ut blandit odio. Proin quis tortor orci.",

    // ... more subpages ...
};



//// QR CODE ARRAY ////

const char* qrContents[][2] = {
  // URL + Human Readable Address
  { "http://test.com", "www.test.com" }
};


// Number of QR codes
int numberOfQRCodes = sizeof(qrContents) / sizeof(qrContents[0]);


//// IMAGE BYTE ARRAYS ////

const unsigned char yourImage [] PROGMEM = {
	// 'BrancoDigital_Logo_128x64, 128x64px
	0x00, 0x00, 0x00, 0x00, 0x00, 0x00, 0x00, 0x00, 0x00, 0x00, 0x00, 0x00, 0x00, 0x00, 0x00, 0x00, 
	0x00, 0x00, 0x00, 0x00, 0x00, 0x00, 0x00, 0x00, 0x00, 0x00, 0x00, 0x00, 0x00, 0x00, 0x00, 0x00, 
	0x00, 0x00, 0x00, 0x00, 0x00, 0x00, 0x00, 0x00, 0x00, 0x00, 0x00, 0x00, 0x00, 0x00, 0x00, 0x00, 
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	0x00, 0x00, 0x00, 0x00, 0x00, 0x00, 0x00, 0x00, 0x00, 0x00, 0x00, 0x00, 0x00, 0x00, 0x00, 0x00
};

const unsigned char CONTROLS01 [] PROGMEM = {
	// 'PCBusinessCard_Controls_01, 128x64px
	0x00, 0x00, 0x00, 0x00, 0x00, 0x00, 0x00, 0x00, 0x00, 0x00, 0x00, 0x00, 0x00, 0x00, 0x00, 0x00, 
	0x00, 0x00, 0x00, 0x00, 0x00, 0x00, 0x00, 0x00, 0x00, 0x00, 0x00, 0x00, 0x00, 0x00, 0x00, 0x00, 
	0x00, 0x00, 0x01, 0xff, 0xff, 0xff, 0xff, 0xff, 0xff, 0xff, 0xff, 0xff, 0xff, 0x80, 0x00, 0x00, 
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	0x00, 0x00, 0x00, 0x00, 0x00, 0x00, 0x00, 0x00, 0x00, 0x00, 0x00, 0x00, 0x00, 0x00, 0x00, 0x00
};

const unsigned char CONTROLS02 [] PROGMEM = {
	// 'PCBusinessCard_Controls_02, 128x64px
	0x00, 0x00, 0x00, 0x00, 0x00, 0x00, 0x00, 0x00, 0x00, 0x00, 0x00, 0x00, 0x00, 0x00, 0x00, 0x00, 
	0x00, 0x00, 0x00, 0x00, 0x00, 0x00, 0x00, 0x00, 0x00, 0x00, 0x00, 0x00, 0x00, 0x00, 0x00, 0x00, 
	0x00, 0x00, 0x01, 0xff, 0xff, 0xff, 0xff, 0xff, 0xff, 0xff, 0xff, 0xff, 0xff, 0x80, 0x00, 0x00, 
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	0x00, 0x00, 0x00, 0x00, 0x00, 0x00, 0x00, 0x00, 0x00, 0x00, 0x00, 0x00, 0x00, 0x00, 0x00, 0x00
};

//// BITMAP ARRAY FOR MENU/CONTENT ////

const uint8_t* bitmaps[] = {
  yourImage,
  //bitmap_01,
  //bitmap_02,
  // ... more bitmaps ...
};

//// VARIABLES AND STATE MACHINE ////

int currentScreen = 0; //Track which screen is currently active. If 0, it's the menu, if any other number load the respective subpage
int menuSelection = 0; // Track current selected item in the menu, if it's 0 it's none
int scrollDepth = 0; // Track current scrollDepth on the subpages, if it's 0 it's the top
int maxScrollDepth = 0; //Track maxScrollDepth for the current subpage
int totalMenuItems = sizeof(menuItems) / sizeof(menuItems[0]); // Get total menu items
int menuScrollDepth = 0; // Tracks the first menu item to be displayed

bool shouldClearScreen = false;


const int MAX_LINES_PER_SCREEN = 4;
const int FONT_WIDTH = 7; // Width of the font in pixels, including spacing
//const int MAX_CHARACTERS_PER_LINE = SCREEN_WIDTH / FONT_WIDTH;

const int MAX_CHARACTERS_PER_LINE = 20; // adjust this according to your display width

unsigned long lastButtonPress = 0; // timestamp of the last button press
unsigned int buttonPressInterval = 200; // time interval in ms between two button presses

// Scroll Depth Definitions

int** scrollDepths = NULL; // A 2D array to store the start and end indices of each scroll depth
const int INITIAL_MAX_SCROLL_DEPTH = 10; // replace with the actual initial max scroll depth

int scrollPosition = 0;


void setup() {
  Serial.begin(9600);

  Wire.begin(SDA_PIN, SCL_PIN);

  // Setup PCF8574. It's important to make sure it starts in a known state
  pcf.begin(0x20);
  
  pcf.pinMode(btnBACK, INPUT);
  pcf.pinMode(btnCONFIRM, INPUT);
  pcf.pinMode(btnUP, INPUT);
  pcf.pinMode(btnDOWN, INPUT);

// SSD1306_SWITCHCAPVCC = generate display voltage from 3.3V internally
  if(!display.begin(SSD1306_SWITCHCAPVCC, SCREEN_ADDRESS)) {
    Serial.println(F("SSD1306 allocation failed"));
    for(;;); // Don't proceed, loop forever
  }

  display.clearDisplay();
  delay(500);
  
  display.drawBitmap(0,0, yourImage, 128, 64, WHITE);
  display.display();
  delay(3000);
  display.clearDisplay();

  controlAnim(CONTROLS01, CONTROLS02, 5, 500);
  display.clearDisplay();
  delay(500);

  }

void controlAnim (const unsigned char* bitmap1, const unsigned char* bitmap2, int loops, int delayMs) {
  for (int i = 0; i < loops; i++) {
    // Display first bitmap
    display.clearDisplay();
    display.drawBitmap(0, 0, bitmap1, SCREEN_WIDTH, SCREEN_HEIGHT, 1);
    display.display();
    delay(delayMs);

    // Display second bitmap
    display.clearDisplay();
    display.drawBitmap(0, 0, bitmap2, SCREEN_WIDTH, SCREEN_HEIGHT, 1);
    display.display();
    delay(delayMs);
  }
}


void drawMenuItem(String label, bool selected, int index) {
  int y = index * 15; // 15 pixel spacing between each item
  display.setTextSize(1); // Set the text size
  display.setCursor(0, y); // Set the cursor to the top-left of the item's area
  
  if (selected) {
    // Draw item as selected (white background, black text)
    display.setTextColor(SSD1306_BLACK, SSD1306_WHITE); // Draw black text on a white background
  } else {
    // Draw item as not selected (black background, white text)
    display.setTextColor(SSD1306_WHITE); // Draw white text
  }

  display.println(label);
}

void drawMenu() {
  int maxMenuIndex = menuScrollDepth + MAX_LINES_PER_SCREEN;
  if (maxMenuIndex > totalMenuItems) maxMenuIndex = totalMenuItems;
  
  for (int i = menuScrollDepth; i < maxMenuIndex; ++i) {
    // Determine whether the current menu item is selected
    bool isSelected = (i == menuSelection);
    // Call drawMenuItem() with the label, selected state, and index of the current menu item
    drawMenuItem(menuItems[i].label, isSelected, i - menuScrollDepth); // Adjusted index to fit within screen boundaries
  }
}

void drawSubPage() {
  display.clearDisplay();
  display.setTextColor(WHITE, BLACK);
  display.setTextSize(1);
  char* subPage = subPages[currentScreen - 1];

  int start = 0, end = 0;
  char lineBuffer[MAX_CHARACTERS_PER_LINE + 1];
  int lastSpacePos = -1;

  int lineIndex = 0;
  int displayedLines = 0;

  while (subPage[end] != '\0' && displayedLines < MAX_LINES_PER_SCREEN) {
    while (subPage[end] != '\0' && subPage[end] != '\n' && end - start < MAX_CHARACTERS_PER_LINE) {
      if (subPage[end] == ' ') {
        lastSpacePos = end;
      }
      ++end;
    }

    if (end - start == MAX_CHARACTERS_PER_LINE && subPage[end] != ' ' && subPage[end] != '\n') {
      if (lastSpacePos != -1) {
        end = lastSpacePos;
        lastSpacePos = -1;
      } else {
        // We're in a long word that's longer than MAX_CHARACTERS_PER_LINE, so we force a break
        start = end - MAX_CHARACTERS_PER_LINE; // Move the start backwards
        lastSpacePos = -1; // Not necessary, but for clarity
      }
    }

    if (lineIndex >= scrollDepth) {
      int copyStart = (subPage[start] == ' ') ? start + 1 : start;
      strncpy(lineBuffer, &subPage[copyStart], end - copyStart);
      lineBuffer[end - copyStart] = '\0'; 
      display.setCursor(0, 15 * displayedLines);
      display.println(lineBuffer);
      displayedLines++;
    }

    if (subPage[end] == '\n') {
      ++end;
    }

    start = end;

    lineIndex++;
  }

  maxScrollDepth = lineIndex;
}

void checkButtons() {
  unsigned long currentMillis = millis();
  if (currentMillis - lastButtonPress > buttonPressInterval) {  // Debouncing
    if (!pcf.digitalRead(btnBACK)) {
      currentScreen = 0; // Navigate back to Menu
      scrollDepth = 0;   // Reset scroll depth
      shouldClearScreen = true;
      //menuScrollDepth = 0; // Reset menu scroll depth
      //Clear ScrollDepth coordinates
      scrollDepths = (int**)malloc(INITIAL_MAX_SCROLL_DEPTH * sizeof(*scrollDepths));
      for (int i = 0; i < INITIAL_MAX_SCROLL_DEPTH; ++i) {
        scrollDepths[i] = (int*)malloc(2 * sizeof(int));
      }
    } else if (!pcf.digitalRead(btnDOWN)) {
      shouldClearScreen = true;
      if (currentScreen == 0) { // On Menu
        if (menuSelection < totalMenuItems - 1) {
          menuSelection++;
          if (menuSelection - menuScrollDepth >= MAX_LINES_PER_SCREEN) {
            menuScrollDepth++;
          }
        }
      } else { // On Subpage
        if (scrollDepth < maxScrollDepth - 2) { // Adjust here, adding an offset of 2 lines
          scrollDepth++;
        }
      }
      lastButtonPress = currentMillis;
    } else if (!pcf.digitalRead(btnUP)) {
      shouldClearScreen = true;

      if (currentScreen == 0) { // On Menu
        if (menuSelection > 0) {
          menuSelection--;
          if (menuSelection < menuScrollDepth) {
            menuScrollDepth--;
          }
        }
      } else { // On Subpage
        if (scrollDepth > 0) {
          scrollDepth--;
        }
      }
      lastButtonPress = currentMillis;
    } else if (!pcf.digitalRead(btnCONFIRM)) {
      if (currentScreen == 0) { // On Menu
        currentScreen = menuSelection + 1;
        scrollDepth = 0; // Reset scroll depth on entering a subpage
        shouldClearScreen = true;
      }
      lastButtonPress = currentMillis;
    }
  }
}

void drawBitmap(int bitmapIndex) {
  //display.clearDisplay();
  display.drawBitmap(0, 0, bitmaps[bitmapIndex], 128, 64, WHITE);
  //display.display();
}

void drawQRCode(int index) {
  uint8_t qrcodeData[qrcode_getBufferSize(2)];

  const char* qrContent = qrContents[index][0];
  const char* qrReadableText = qrContents[index][1];

  qrcode_initText(&qrcode, qrcodeData, 2, ECC_LOW, qrContent);

  int scale = min(SCREEN_WIDTH / qrcode.size, SCREEN_HEIGHT / qrcode.size);
  int qrX = max((SCREEN_WIDTH - (qrcode.size * scale)) / 2, 0);
  
  // Subtract 3 from the y-position to move the QR code up a bit
  int qrY = max((SCREEN_HEIGHT - (qrcode.size * scale)) / 2, 0) - 3;

  // Fill the screen with a white rectangle
  display.fillRect(0, 0, SCREEN_WIDTH, SCREEN_HEIGHT, WHITE);

  for (uint8_t y = 0; y < qrcode.size; y++) {
    for (uint8_t x = 0; x < qrcode.size; x++) {
      if (qrcode_getModule(&qrcode, x, y)) {
        display.fillRect(qrX + x * scale, qrY + y * scale, scale, scale, BLACK);
      }
    }
  }

  // Print the human-readable text under the QR code
  int textWidth = 6 * strlen(qrReadableText); // Calculate the width of the text in pixels
  int textX = max((SCREEN_WIDTH - textWidth) / 2, 0); // Calculate the x-position to center the text

  display.setTextColor(BLACK); // Set the text color to black
  display.setCursor(textX, SCREEN_HEIGHT - 8); // Position the cursor to center the text at the bottom of the screen
  display.println(qrReadableText);
}

void loop() {
  //Check if there was a button press
  checkButtons();

  if (shouldClearScreen) {
    display.clearDisplay();
    shouldClearScreen = false;
  }

  if (currentScreen == 0) {
    // Draw the menu
    drawMenu();
  } else {
    switch (menuItems[currentScreen - 1].type) {
      case PAGE_TEXT:
        drawSubPage();
        break;
      case PAGE_BITMAP:
        drawBitmap(menuItems[currentScreen - 1].bitmapIndex);
        break;
      case PAGE_QRCODE:
        drawQRCode(menuItems[currentScreen - 1].qrCodeIndex);
        break;
    }
  }

  // Update the display
  display.display();
}
